## west.yml
```yaml
manifest:
  defaults:
    remote: upstream

    
  remotes:
    - name: upstream
      url-base: https://github.com/zephyrproject-rtos
    - name: babblesim
      url-base: https://github.com/BabbleSim

  group-filter: [-babblesim, -optional, -testing]

  projects:
    - name: zephyr
      remote: upstream
      revision: v4.4.1
      path: zephyr

    - name: cmsis
      revision: 512cc7e895e8491696b61f7ba8066b4a182569b8
      path: modules/hal/cmsis
      groups:
        - hal
    - name: cmsis-dsp
      revision: 97512610ec92058f0119450b9e743eeb7e95b5c8
      path: modules/lib/cmsis-dsp
    - name: cmsis-nn
      revision: d20117c9e88cf9018d6fa06744dddac700c3e3a1
      path: modules/lib/cmsis-nn
    - name: cmsis_6
      repo-path: CMSIS_6
      revision: 30a859f44ef8ab4dc8f84b03ed586fd16ccf9d74
      path: modules/hal/cmsis_6
      groups:
        - hal

    - name: hal_st
      revision: 7a792882847223c72944791e0c48eed6101e6569
      path: modules/hal/st
      groups:
        - hal
    - name: hal_stm32
      revision: fc11896dd39cfca37bf9b4aeaaa2df8861b81875
      path: modules/hal/stm32
      groups:
        - hal
    - name: picolibc
      path: modules/lib/picolibc
      revision: 01254932e8e81085817ed61fd858648584ffe37c
      
  self:
    west-commands: scripts/west-commands.yml
```
